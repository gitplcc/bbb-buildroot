## Config.in
```kconfig
menu "Mis Aplicaciones Propias"
    source "$BR2_EXTERNAL_BBB_PATH/package/lector-iio/Config.in"
endmenu
```

## bbb/Config.in
```kconfig
menu "Custom apps"
    source "$BR2_EXTERNAL_BBB_PATH/package/lector-iio/Config.in"
endmenu
```

## bbb/package/lector-iio/Config.in
```kconfig
config BR2_PACKAGE_LECTOR_IIO
	bool "lector-iio"
	select BR2_PACKAGE_LIBIIO
	help
	  Custom application in C to read the analog channels of IIO
	  of the BeagleBone Black.

comment "lector-iio needs the libiio library"
	depends on !BR2_PACKAGE_LIBIIO
```

## package/lector-iio/Config.in
```kconfig
config BR2_PACKAGE_LECTOR_IIO
	bool "lector-iio"
	select BR2_PACKAGE_LIBIIO
	help
	  Aplicación propia en C para leer los canales analógicos IIO
	  de la BeagleBone Black.

comment "lector-iio necesita obligatoriamente la biblioteca libiio"
	depends on !BR2_PACKAGE_LIBIIO
```
